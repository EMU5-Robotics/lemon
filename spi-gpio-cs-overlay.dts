/dts-v1/;
/plugin/;

/ {
    compatible = "brcm,bcm2835", "brcm,bcm2836", "brcm,bcm2708", "brcm,bcm2709";

    fragment@0 {
        target = <&spi0_cs_pins>;
        frag0: __overlay__ {
            brcm,pins = <19>;
	    brcm,function = <1>;
        };
    };

    fragment@1 {
        target = <&spi0>;
        frag1: __overlay__ {
            #address-cells = <1>;
            #size-cells = <0>;
            pinctrl-0 = <&spi0_pins &spi0_cs_pins>;
            status = "okay";
            cs-gpios = <&gpio 8 1>, <&gpio 7 1>, <&gpio 19 1>;

                 spidev@2{
                        compatible = "spidev";
                        reg = <2>;
                        #address-cells = <1>;
                        #size-cells = <0>;
                        spi-max-frequency = <500000>;
                 };
        };
    };

};
